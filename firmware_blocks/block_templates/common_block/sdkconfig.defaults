## firmware_blocks/block_templates/led_color_flash_block/sdkconfig.defaults
```kconfig
CONFIG_CCACHE_ENABLE=y
CONFIG_FREERTOS_HZ=1000
CONFIG_ESPTOOLPY_FLASHSIZE_4MB=y
CONFIG_ESPTOOLPY_FLASHSIZE="4MB"
```

## firmware_blocks/block_templates/music_sequence_block_2/sdkconfig.defaults
```kconfig
CONFIG_CCACHE_ENABLE=y
CONFIG_FREERTOS_HZ=1000
CONFIG_ADC_SKIP_LEGACY_CONFLICT_CHECK=y
CONFIG_ESPTOOLPY_FLASHSIZE_4MB=y
CONFIG_ESPTOOLPY_FLASHSIZE="4MB"
CONFIG_PARTITION_TABLE_CUSTOM=y
CONFIG_PARTITION_TABLE_CUSTOM_FILENAME="partitions.csv"
CONFIG_PARTITION_TABLE_FILENAME="partitions.csv"
```

## firmware_blocks/block_templates/note_block_2/sdkconfig.defaults
```kconfig
CONFIG_CCACHE_ENABLE=y
CONFIG_COMPILER_OPTIMIZATION_PERF=y
CONFIG_COMPILER_OPTIMIZATION_ASSERTIONS_ENABLE=y
CONFIG_FREERTOS_HZ=1000
CONFIG_ADC_SKIP_LEGACY_CONFLICT_CHECK=y
CONFIG_ESPTOOLPY_FLASHSIZE_4MB=y
CONFIG_ESPTOOLPY_FLASHSIZE="4MB"
```

## firmware_blocks/block_templates/then_block/sdkconfig.defaults
```kconfig
CONFIG_FREERTOS_HZ=1000
CONFIG_ADC_SKIP_LEGACY_CONFLICT_CHECK=y
CONFIG_LV_USE_GIF=n
CONFIG_ESPTOOLPY_FLASHSIZE_4MB=y
CONFIG_ESPTOOLPY_FLASHSIZE="4MB"
CONFIG_CCACHE_ENABLE=y
```

## firmware_blocks/brain_block/main/Kconfig.projbuild
```kconfig
menu "Brain Block Configuration"

    config DEBUG_JSON_FORMATTED
        bool "Enable formatted JSON output for debugging"
        default n
        help
            When enabled, JSON output will be formatted with indentation and newlines,
            making it easier to read in logs during development and debugging.
            When disabled (default), JSON output is compact/unformatted to reduce
            message size over the network.
            
            Enable this option for development/debugging purposes.
            Disable for production to optimize network bandwidth.

endmenu
```
